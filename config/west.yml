## config/west.yml
```yaml
manifest:
  remotes:
    - name: germain-gadel
      url-base: https://github.com/germain-gadel
    - name: zmkfirmware
      url-base: https://github.com/zmkfirmware
  projects:
    - name: zmk
      remote: zmkfirmware
      revision: v0.2
      import: app/west.yml
  self:
    path: config
```
